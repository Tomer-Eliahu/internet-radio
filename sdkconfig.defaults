## sdkconfig.defaults
```kconfig
CONFIG_ESP_MAIN_TASK_STACK_SIZE=120000
CONFIG_ESP_SYSTEM_EVENT_TASK_STACK_SIZE=8000

CONFIG_FREERTOS_ISR_STACKSIZE=8000
#https://docs.espressif.com/projects/esp-idf/en/latest/esp32/api-reference/kconfig-reference.html#config-freertos-isr-stacksize

#Can disable CONFIG_FREERTOS_CHECK_STACKOVERFLOW_CANARY for performance.
CONFIG_FREERTOS_CHECK_STACKOVERFLOW_CANARY=y
CONFIG_ESP_SYSTEM_HW_STACK_GUARD=y

CONFIG_ESP_IPC_TASK_STACK_SIZE=8000
#https://docs.espressif.com/projects/esp-idf/en/latest/esp32/api-reference/kconfig-reference.html#config-esp-ipc-task-stack-size

CONFIG_ESP_TIMER_TASK_STACK_SIZE=10000
#https://docs.espressif.com/projects/esp-idf/en/latest/esp32/api-reference/kconfig-reference.html#config-esp-timer-task-stack-size

CONFIG_LWIP_TCPIP_TASK_STACK_SIZE=20000
#https://docs.espressif.com/projects/esp-idf/en/latest/esp32/api-reference/kconfig-reference.html#config-lwip-tcpip-task-stack-size

CONFIG_PTHREAD_TASK_STACK_SIZE_DEFAULT=8000
CONFIG_PTHREAD_STACK_MIN=5000

CONFIG_ESP_MINIMAL_SHARED_STACK_SIZE=3000
CONFIG_FREERTOS_IDLE_TASK_STACKSIZE=3000

#-------------------------------Stack settings above----------------------


# Use this to set FreeRTOS kernel tick frequency to 1000 Hz (100 Hz by default).
# This allows to use 1 ms granularity for thread sleeps (10 ms by default).
CONFIG_FREERTOS_HZ=1000

# Workaround for https://github.com/espressif/esp-idf/issues/7631
#CONFIG_MBEDTLS_CERTIFICATE_BUNDLE=n
#CONFIG_MBEDTLS_CERTIFICATE_BUNDLE_DEFAULT_FULL=n

# When a panic occurs, the MCU will pause execution (instead of restarting).
CONFIG_ESP_SYSTEM_PANIC_GDBSTUB=y


#
# SPIRAM (PSRAM)
#
# The chip on the Korvo 2 V3.1: ESP32-S3-WROOM-1-N8R8, 8 MB QSPI flash, 8 MB Octal PSRAM.
# We need to enable the additional PSRAM.
CONFIG_SPIRAM=y
CONFIG_SPIRAM_TYPE_AUTO=y
CONFIG_SPIRAM_MODE_OCT=y
CONFIG_SPIRAM_USE_MALLOC=y

CONFIG_SPIRAM_SPEED_80M=y
#CONFIG_SPIRAM_SPEED_40M=y

CONFIG_SPIRAM_XIP_FROM_PSRAM=y

CONFIG_SPIRAM_BOOT_INIT=y
CONFIG_SPIRAM_BOOT_HW_INIT=y

CONFIG_SPIRAM_ECC_ENABLE=y
CONFIG_SPIRAM_TRY_ALLOCATE_WIFI_LWIP=y

# Allocate everything big possible on PSRAM instead of internal RAM 
# (we want as much internal RAM as possible for DMA).
CONFIG_SPIRAM_MALLOC_ALWAYSINTERNAL=200

#CONFIG_SPIRAM_MALLOC_RESERVE_INTERNAL=60000 # This has no actual impact. It is better if we don't use it.


CONFIG_SPIRAM_ALLOW_BSS_SEG_EXTERNAL_MEMORY=y
CONFIG_SPIRAM_ALLOW_NOINIT_SEG_EXTERNAL_MEMORY=y

#CONFIG_SPIRAM_MEMTEST=y -- already runs for us

#PSRAM resources: https://docs.espressif.com/projects/esp-idf/en/latest/esp32s3/api-reference/kconfig-reference.html#esp-psram
# https://docs.espressif.com/projects/esp-idf/en/stable/esp32s3/api-guides/external-ram.html#provide-external-ram-via-malloc


#
# Wi-Fi
#
CONFIG_ESP_WIFI_STATIC_RX_BUFFER_NUM=25
# 25 is the max. Each of these buffers is about 1.6KB. So 25*1.6= 40KB.

CONFIG_ESP_WIFI_STATIC_TX_BUFFER_NUM=5
# Instead of the default 16. We pass these "saved" buffers into CONFIG_ESP_WIFI_STATIC_RX_BUFFER_NUM instead
# and other uses of DMA memory.

CONFIG_ESP_WIFI_DYNAMIC_RX_BUFFER_NUM=128
CONFIG_ESP_WIFI_DYNAMIC_TX_BUFFER_NUM=64

CONFIG_ESP_WIFI_AMPDU_TX_ENABLED=y
CONFIG_ESP_WIFI_AMPDU_RX_ENABLED=y

# 32 is the max for the BA_WIN
CONFIG_ESP_WIFI_TX_BA_WIN=32
CONFIG_ESP_WIFI_RX_BA_WIN=32 


#
# LWIP
#
#CONFIG_LWIP_WND_SCALE=y

# Note these are the max sizes we have for sure as the TCP window scaling option which enables higher values
# must be supported by both us and the transmitting radio station, so we can't rely on that.
#CONFIG_LWIP_TCP_SND_BUF_DEFAULT=65534
CONFIG_LWIP_TCP_WND_DEFAULT=65534


CONFIG_LWIP_TCPIP_RECVMBOX_SIZE=64
CONFIG_LWIP_TCP_RECVMBOX_SIZE=64

# UDP max is 64
CONFIG_LWIP_UDP_RECVMBOX_SIZE=64


#CONFIG_LWIP_L2_TO_L3_COPY=y

# Extra optimizations (These take DMA memory and don't seem critical)
#CONFIG_LWIP_IRAM_OPTIMIZATION=y
#CONFIG_LWIP_EXTRA_IRAM_OPTIMIZATION=y


#
# MBEDTLS
#
# Allocate all required MBEDTLS dynamic allocations from external SPIRAM (PSRAM) instead of internal DRAM
CONFIG_MBEDTLS_EXTERNAL_MEM_ALLOC=y

# Maybe also try (best not if not needed)
#CONFIG_MBEDTLS_DYNAMIC_BUFFER
```
